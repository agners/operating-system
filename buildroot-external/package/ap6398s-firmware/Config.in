## buildroot-external/package/ap6398s-firmware/Config.in
```kconfig
config BR2_PACKAGE_AP6398S_FIRMWARE
	bool "Wi-Fi/Bluetooth firmware for Broadcom AP6398S/BCM4359"
	help
	  Wi-Fi/Bluetooth firmware for Broadcom AP6398S/BCM4359.
```

## buildroot-external/package/ha-green-led-overlays/Config.in
```kconfig
menuconfig BR2_PACKAGE_HA_GREEN_LED_OVERLAYS
	bool "Device-tree overlays for Home Assistant Green LEDs"
	help
	  This builds device tree overlays specifically for
	  Home Assistant Green.
```
